/dts-v1/;
/plugin/;
/ {
	compatible = "brcm,bcm2711";
	fragment@0 {
		target-path = "/";
		__overlay__ {
			my_device {
				compatible = "my_dev_gpio";
				status = "okay";
				label = "gpio_led";
                my_value = <15>;
				led-gpio = <&gpio 12 0>;
                
			};
		};
	};
};